AUTOSAR XML (schema 00046)
package /MICROSAR/SomeIpXf_ib_bswmd/BswModuleDescriptions
  bsw module description SomeIpXf
    bsw internal behavior SomeIpXfBehavior
