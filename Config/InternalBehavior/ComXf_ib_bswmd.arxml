AUTOSAR XML (schema 00046)
package /MICROSAR/ComXf_ib_bswmd/BswModuleDescriptions
  bsw module description ComXf
    bsw internal behavior ComXfBehavior
