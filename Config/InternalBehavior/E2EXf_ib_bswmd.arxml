AUTOSAR XML (schema 00046)
package /MICROSAR/E2EXf_ib_bswmd/BswModuleDescriptions
  bsw module description E2EXf
    bsw internal behavior E2EXfBehavior
