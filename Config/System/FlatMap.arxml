AUTOSAR XML (schema 00046)
package /COM/VECTOR/CFG/WORKFLOW/SYSDESC/SYNC
  flat map FLATMAP
    flat instance descriptor Proto_HeadLight: upstream-reference=EcuSwComposition.Proto_HeadLight, ecu-extract-reference=COMPOSITIONTYPE.Proto_HeadLight
    flat instance descriptor Proto_LightSwitch: upstream-reference=EcuSwComposition.Proto_LightSwitch, ecu-extract-reference=COMPOSITIONTYPE.Proto_LightSwitch
    flat instance descriptor MySWC: upstream-reference=EcuSwComposition.MySWC, ecu-extract-reference=COMPOSITIONTYPE.MySWC
