AUTOSAR XML (schema 00046)
package /ActiveEcuC
  module config Mcu: implementation-config-variant=VARIANT-PRE-COMPILE, module-description=Mcu_Impl
    McuPublishedInformation
    McuGeneralConfiguration:
      McuDevErrorDetect = true
      McuGetRamStateApi = false
      McuInitClock = true
      McuNoPll = true
      McuPerformResetApi = true
      McuVersionInfoApi = false
      McuSafeBswChecks = false
    McuModuleConfiguration
      4 x McuModeSettingConf:
        SLEEP: McuMode=1, McuVttMode=VTTMCU_MODE_SLEEP
        POWER_OFF: McuMode=3, McuVttMode=VTTMCU_MODE_POWER_OFF
        RESET: McuMode=2, McuVttMode=VTTMCU_MODE_RESET
        NORMAL: McuMode=0, McuVttMode=VTTMCU_MODE_NORMAL
      McuClockSettingConfig
        McuClockReferencePoint: McuClockReferencePointFrequency=80000000
