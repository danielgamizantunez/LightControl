AUTOSAR XML (schema 00046)
package /ActiveEcuC
  module config SomeIpXf: implementation-config-variant=VARIANT-PRE-COMPILE, module-description=SomeIpXf_Impl
    XfrmGeneral: XfrmDevErrorDetect=true, XfrmVersionInfoApi=false
