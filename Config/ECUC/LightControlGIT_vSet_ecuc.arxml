AUTOSAR XML (schema 00046)
package /ActiveEcuC
  module config vSet: implementation-config-variant=VARIANT-PRE-COMPILE, module-description=vSet_Impl
    vSetCalibration
    vSetGeneral: vSetDummyStatementKind=SelfAssignment
    vSetPlatform:
      vSetSizeOfRAMPointer = Size32Bit
      vSetSizeOfInt = Size32Bit
      vSetSizeOfEnum = Size32Bit
      vSetSizeOfROMPointer = Size32Bit
      vSetCPUType = CPU32Bit
      vSetByteOrder = LITTLE_ENDIAN
      vSetBitOrder = MSB_to_LSB
