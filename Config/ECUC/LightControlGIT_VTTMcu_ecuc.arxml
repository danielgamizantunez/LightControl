AUTOSAR XML (schema 00046)
package /ActiveEcuC
  module config VTTMcu: implementation-config-variant=VARIANT-PRE-COMPILE, module-description=VTTMcu_Impl
    McuGeneralConfiguration:
      McuDevErrorDetect = true
      McuGetRamStateApi = false
      McuInitClock = true
      McuNoPll = true
      McuPerformResetApi = true
      McuVersionInfoApi = false
      McuSafeBswChecks = false
    McuPublishedInformation
    McuModuleConfiguration
      McuClockSettingConfig
      4 x McuModeSettingConf:
        NORMAL: McuMode=0, McuVttMode=VTTMCU_MODE_NORMAL
        RESET: McuMode=2, McuVttMode=VTTMCU_MODE_RESET
        SLEEP: McuMode=1, McuVttMode=VTTMCU_MODE_SLEEP
        POWER_OFF: McuMode=3, McuVttMode=VTTMCU_MODE_POWER_OFF
