AUTOSAR XML (schema 00046)
package /ActiveEcuC
  module config Os: implementation-config-variant=VARIANT-PRE-COMPILE, module-description=Os_Impl
    OsPublishedInformation: OsKernelVersion=7, OsPlatformName=VTT
      VTT (OsDerivativeInformation):
        OsExceptionVectorTableAlignment = 0
        OsInterruptVectorTableAlignment = 0
        OsHardwareManuals = N/A
        OsMpuAlignment = 0
        OsMpuEndAddressAccessible = true
        OsStackAlignment = 0
        OsSystemIntCtrl: OsSystemIntCtrlPrioOrder=ASC, OsSystemIntCtrlMaxPrios=200, OsSystemIntCtrlBaseAddress=0, OsSystemIntCtrlMaxSources=10000
        DEFAULT (OsInterruptSupportedType): OsInterruptSupportedTypeSeparateSources=false, OsInterruptSupportedTypeSeparatePriority=false
        STM0 (OsHardwareTimer): OsHardwareTimerUnit=FRT, OsHardwareTimerId=0, OsHardwareTimerSize=32, OsHardwareTimerBaseAddress=0
          STM0_Ch0 (OsHardwareTimerChannel): OsHardwareTimerChannelId=0, OsHardwareTimerChannelIntSource=0, OsHardwareTimerChannelOffset=0
        PIT0 (OsHardwareTimer): OsHardwareTimerUnit=PIT, OsHardwareTimerId=0, OsHardwareTimerSize=32, OsHardwareTimerBaseAddress=0
          PIT0_Ch0 (OsHardwareTimerChannel): OsHardwareTimerChannelId=0, OsHardwareTimerChannelIntSource=0, OsHardwareTimerChannelOffset=0
        OsPhysicalCore0 (OsPhysicalCore):
          OsPhysicalCoreIsAutostart = true
          OsPhysicalCoreId = 0
          OsPhysicalCoreExceptionSources = 0
          OsPhysicalCoreMasterStartAllowed = false
          OsPhysicalCorePrivelegedHwAccess = false
    OS_APPMODE_ANY (OsAppMode)
    OSDEFAULTAPPMODE (OsAppMode)
    OsOS:
      OsStackMonitoring = true
      OsStatus = EXTENDED
      OsUseGetServiceId = false
      OsUseParameterAccess = false
      OsUseResScheduler = false
      OsForcibleTermination = false
      OsGenerateCalloutStubs = true
      OsGenerateMemMap = COMPLETE
      OsGenerateMemMapForNearAddressing = true
      OsGenerateMemMapForThreads = false
      OsServiceProtection = false
      OsStackUsageMeasurement = false
      OsUseXSignalAsyncApiCalls = false
      OsFpuUsage = NONE
      OsNumberOfCores = 1
      OsScalabilityClass = SC1
      OsMasterCore = MyOsCore0
      OsSystemTimer = SystemTimer
      OsStackSummary
        6 x OsStack, all with OsStackCore=MyOsCore0:
          MyOsCore0_Error: OsStackSize=1024, OsStackType=CORE_ERROR_STACK, OsStackUser=MyOsCore0
          MyOsCore0_Init: OsStackSize=1024, OsStackType=CORE_INIT_STACK, OsStackUser=MyOsCore0
          MyOsCore0_Kernel: OsStackSize=1024, OsStackType=CORE_KERNEL_STACK, OsStackUser=MyOsCore0
          MyOsCore0_Task_Prio4294967295: OsStackSize=1000, OsStackType=TASK_SHARED_PRIORITY_STACK, OsStackUser=IdleTask_OsCore0
          MyOsCore0_Isr_Core: OsStackSize=1024, OsStackType=ISR_SHARED_CORE_STACK, OsStackUser=CounterIsr_SystemTimer
          MyOsCore0_Task_Prio0: OsStackSize=1024, OsStackType=TASK_SHARED_PRIORITY_STACK, OsStackUser=OsTask_002, OsStackUser=OsTask, OsStackUser=OsTask_003, OsStackUser=OsTask_004
      OsHooks: OsErrorHook=true, OsPostTaskHook=false, OsPreTaskHook=false, OsShutdownHook=false, OsStartupHook=false
    SystemTimer (OsCounter):
      OsCounterMaxAllowedValue = 2147483647
      OsCounterMinCycle = 1
      OsCounterType = HARDWARE
      OsSecondsPerTick = 0.001
      OsCounterTicksPerBase = 1
      OsCounterAccessingApplication = SystemApplication_OsCore0
      OsDriver: OsDriverHighResolution=false, OsDriverHardwareTimerChannelRef=PIT0_Ch0, OsDriverIsrRef=CounterIsr_SystemTimer
    MyOsCore0 (OsCore):
      OsCoreIsAutosar = true
      OsCoreIsAutostart = true
      OsCorePhysicalCoreRef = OsPhysicalCore0
      OsCoreIdleTask = IdleTask_OsCore0
      OsCoreSystemApplication = SystemApplication_OsCore0
      OsCoreEcucCoreRef = EcucCoreDefinition
      OsCoreStacks:
        OsCoreKernelStackSize = 1024
        OsCoreStartupStackSize = 1024
        OsCoreShutdownStackSize = 1024
        OsCoreErrorStackSize = 1024
        OsCoreProtectionStackSize = 1024
        OsCoreInitStackSize = 1024
    IdleTask_OsCore0 (OsTask):
      OsTaskActivation = 1
      OsTaskPriority = 4294967295
      OsTaskSchedule = FULL
      OsTaskStackSharing = false
      OsTaskStackSize = 1000
      OsTaskType = AUTO
      OsTaskUsesFpu = false
      OsTaskAccessingApplication = SystemApplication_OsCore0
      OsTaskAutostart: OsTaskAppModeRef=OS_APPMODE_ANY
    SystemApplication_OsCore0 (OsApplication):
      OsTrusted = true
      OsTrustedApplicationDelayTimingViolationCall = false
      OsTrustedApplicationWithProtection = false
      OsApplicationIsPrivileged = true
      OsAppUseTrustedFunctionStubs = false
      OsApplicationCoreRef = EcucCoreDefinition
      OsAppTaskRef = IdleTask_OsCore0
      OsAppCounterRef = SystemTimer
      OsAppIsrRef = CounterIsr_SystemTimer
      OsAppTaskRef = OsTask
      OsAppTaskRef = OsTask_{002..004}
      OsApplicationHooks: OsAppErrorHook=false, OsAppShutdownHook=false, OsAppStartupHook=false
    CounterIsr_SystemTimer (OsIsr):
      OsIsrCategory = CATEGORY_2
      OsIsrInterruptType = EXTERNAL
      OsIsrInterruptSource = 1
      OsIsrInterruptPriority = 0
      OsIsrStackSize = 1024
      OsIsrEnableNesting = false
      OsIsrUsesFpu = false
      OsIsrInitialEnableInterruptSource = false
      OsIsrSpecialFunctionName = Os_TimerPitIsr
    4 x OsTask, all with OsTaskActivation=1, OsTaskPriority=0, OsTaskStackSharing=false, OsTaskStackSize=1024, OsTaskType=AUTO, OsTaskUsesFpu=false, OsTaskAccessingApplication=SystemApplication_OsCore0:
      OsTask: OsTaskSchedule=FULL, OsTaskResourceRef=OsResource
      OsTask_002: OsTaskSchedule=NON
      OsTask_003: OsTaskSchedule=FULL
      OsTask_004: OsTaskSchedule=FULL
    OsResource: OsResourceProperty=STANDARD, OsResourceAccessingApplication=SystemApplication_OsCore0
