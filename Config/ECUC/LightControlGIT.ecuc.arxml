AUTOSAR XML (schema 00046)
package /ActiveEcuC
  ecuc value collection ActiveEcuC: ecu-extract=SYSTEM
    ecuc-values:
      Com
      Mcu
      Rte
      EcuM
      VTTMcu
      E2EXf
      VTTCntrl
      CanNm
      Os
      PduR
      VTTEcuC
      CanSM
      Nm
      Can
      CanIf
      ComXf
      Det
      ComM
      VTTCan
      EcuC
      BswM
      vSet
      SomeIpXf
      VTTOs
