AUTOSAR XML (schema 00046)
package /ActiveEcuC
  module config Rte: implementation-config-variant=VARIANT-PRE-COMPILE, module-description=Rte_Impl
    RteInitializationBehavior: RteInitializationStrategy=RTE_INITIALIZATION_STRATEGY_AT_DATA_DECLARATION, RteSectionInitializationPolicy=INIT
    RteGeneration:
      RteGenerationMode = COMPATIBILITY_MODE
      RteIocInteractionReturnValue = RTE_IOC
      RteValueRangeCheckEnabled = false
      RteCalibrationSupport = NONE
      RteCodeVendorId = 30
      RteDevErrorDetect = false
      RteDevErrorDetectUninit = false
      RteMeasurementSupport = false
      RteOptimizationMode = MEMORY
      RteVfbTraceEnabled = false
    RteBswGeneral: RteSchMVersionInfoApi=false, RteUseComShadowSignalApi=false
    RteOsInteraction
    15 x RteBswModuleInstance:
      BswM: RteBswImplementationRef=BswM_Impl, RteBswModuleConfigurationRef=BswM
        BSWM_EXCLUSIVE_AREA_0 (RteBswExclusiveAreaImpl): RteExclusiveAreaImplMechanism=ALL_INTERRUPT_BLOCKING, RteBswExclusiveAreaRef=BSWM_EXCLUSIVE_AREA_0
        BswM_MainFunctionTimingEvent0 (RteBswEventToTaskMapping): RteBswImmediateRestart=false, RteBswEventRef=BswM_MainFunctionTimingEvent0
      Can: RteBswImplementationRef=Can_Impl, RteBswModuleConfigurationRef=Can
        3 x RteBswEventToTaskMapping, all with RteBswImmediateRestart=false:
          Can_MainFunction_BusOffTimingEvent0: RteBswEventRef=Can_MainFunction_BusOffTimingEvent0
          Can_MainFunction_WakeupTimingEvent0: RteBswEventRef=Can_MainFunction_WakeupTimingEvent0
          Can_MainFunction_ModeTimingEvent0: RteBswEventRef=Can_MainFunction_ModeTimingEvent0
        8 x RteBswExclusiveAreaImpl, all with RteExclusiveAreaImplMechanism=ALL_INTERRUPT_BLOCKING:
          CAN_EXCLUSIVE_AREA_{0..7}: RteBswExclusiveAreaRef=CAN_EXCLUSIVE_AREA_{0..7}
      CanIf: RteBswImplementationRef=CanIf_Impl, RteBswModuleConfigurationRef=CanIf
        8 x RteBswExclusiveAreaImpl, all with RteExclusiveAreaImplMechanism=ALL_INTERRUPT_BLOCKING:
          CANIF_EXCLUSIVE_AREA_{0..7}: RteBswExclusiveAreaRef=CANIF_EXCLUSIVE_AREA_{0..7}
      CanNm: RteBswImplementationRef=CanNm_Impl, RteBswModuleConfigurationRef=CanNm
        CanNm_MainFunctionTimingEvent0 (RteBswEventToTaskMapping): RteBswImmediateRestart=false, RteBswEventRef=CanNm_MainFunctionTimingEvent0
        7 x RteBswExclusiveAreaImpl, all with RteExclusiveAreaImplMechanism=ALL_INTERRUPT_BLOCKING:
          CANNM_EXCLUSIVE_AREA_{0..6}: RteBswExclusiveAreaRef=CANNM_EXCLUSIVE_AREA_{0..6}
      CanSM: RteBswImplementationRef=CanSM_Impl, RteBswModuleConfigurationRef=CanSM
        CanSM_MainFunctionTimingEvent0 (RteBswEventToTaskMapping): RteBswImmediateRestart=false, RteBswEventRef=CanSM_MainFunctionTimingEvent0
        6 x RteBswExclusiveAreaImpl, all with RteExclusiveAreaImplMechanism=ALL_INTERRUPT_BLOCKING:
          CANSM_EXCLUSIVE_AREA_{1..6}: RteBswExclusiveAreaRef=CANSM_EXCLUSIVE_AREA_{1..6}
      Com: RteBswImplementationRef=Com_Impl, RteBswModuleConfigurationRef=Com
        Com_MainFunctionTxTimingEvent0 (RteBswEventToTaskMapping): RteBswImmediateRestart=false, RteBswEventRef=Com_MainFunctionTxTimingEvent0
        Com_MainFunctionRxTimingEvent0 (RteBswEventToTaskMapping): RteBswImmediateRestart=false, RteBswEventRef=Com_MainFunctionRxTimingEvent0
        3 x RteBswExclusiveAreaImpl, all with RteExclusiveAreaImplMechanism=ALL_INTERRUPT_BLOCKING:
          COM_EXCLUSIVE_AREA_TX: RteBswExclusiveAreaRef=COM_EXCLUSIVE_AREA_TX
          COM_EXCLUSIVE_AREA_RX: RteBswExclusiveAreaRef=COM_EXCLUSIVE_AREA_RX
          COM_EXCLUSIVE_AREA_BOTH: RteBswExclusiveAreaRef=COM_EXCLUSIVE_AREA_BOTH
      ComM: RteBswImplementationRef=ComM_Impl, RteBswModuleConfigurationRef=ComM
        ComM_MainFunction_0TimingEvent0 (RteBswEventToTaskMapping): RteBswImmediateRestart=false, RteBswEventRef=ComM_MainFunction_0TimingEvent0
        COMM_EXCLUSIVE_AREA_0 (RteBswExclusiveAreaImpl): RteExclusiveAreaImplMechanism=ALL_INTERRUPT_BLOCKING, RteBswExclusiveAreaRef=COMM_EXCLUSIVE_AREA_0
        COMM_EXCLUSIVE_AREA_1 (RteBswExclusiveAreaImpl): RteExclusiveAreaImplMechanism=ALL_INTERRUPT_BLOCKING, RteBswExclusiveAreaRef=COMM_EXCLUSIVE_AREA_1
      ComXf: RteBswImplementationRef=ComXf_Impl, RteBswModuleConfigurationRef=ComXf
      Det: RteBswImplementationRef=Det_Impl, RteBswModuleConfigurationRef=Det
        DET_EXCLUSIVE_AREA_0 (RteBswExclusiveAreaImpl): RteExclusiveAreaImplMechanism=ALL_INTERRUPT_BLOCKING, RteBswExclusiveAreaRef=DET_EXCLUSIVE_AREA_0
      E2EXf: RteBswImplementationRef=E2EXf_Impl, RteBswModuleConfigurationRef=E2EXf
      EcuM: RteBswImplementationRef=EcuM_Impl, RteBswModuleConfigurationRef=EcuM
        EcuM_MainFunctionTimingEvent0 (RteBswEventToTaskMapping): RteBswImmediateRestart=false, RteBswEventRef=EcuM_MainFunctionTimingEvent0
        3 x RteBswExclusiveAreaImpl, all with RteExclusiveAreaImplMechanism=ALL_INTERRUPT_BLOCKING:
          ECUM_EXCLUSIVE_AREA_{0..2}: RteBswExclusiveAreaRef=ECUM_EXCLUSIVE_AREA_{0..2}
      Nm: RteBswImplementationRef=Nm_Impl, RteBswModuleConfigurationRef=Nm
        NM_EXCLUSIVE_AREA_0 (RteBswExclusiveAreaImpl): RteExclusiveAreaImplMechanism=ALL_INTERRUPT_BLOCKING, RteBswExclusiveAreaRef=NM_EXCLUSIVE_AREA_0
        NM_EXCLUSIVE_AREA_1 (RteBswExclusiveAreaImpl): RteExclusiveAreaImplMechanism=ALL_INTERRUPT_BLOCKING, RteBswExclusiveAreaRef=NM_EXCLUSIVE_AREA_1
      PduR: RteBswImplementationRef=PduR_Impl, RteBswModuleConfigurationRef=PduR
        PDUR_EXCLUSIVE_AREA_0 (RteBswExclusiveAreaImpl): RteExclusiveAreaImplMechanism=ALL_INTERRUPT_BLOCKING, RteBswExclusiveAreaRef=PDUR_EXCLUSIVE_AREA_0
      Rte: RteBswImplementationRef=Rte_Impl, RteBswModuleConfigurationRef=Rte
      SomeIpXf: RteBswImplementationRef=SomeIpXf_Impl, RteBswModuleConfigurationRef=SomeIpXf
    5 x RteSwComponentInstance:
      EcuM_EcuSwComposition: RteSoftwareComponentInstanceRef=EcuM
        8 x RteEventToTaskMapping, all with RteImmediateRestart=false:
          Timer_EcuM_MainFunction: RteEventRef=Timer_EcuM_MainFunction
          OpEventSelectShutdownTarget_SelectShutdownTarget_EcuM_ShutdownTarget: RteEventRef=OpEventSelectShutdownTarget_SelectShutdownTarget_EcuM_ShutdownTarget
          OpEventGetShutdownTarget_GetShutdownTarget_EcuM_ShutdownTarget: RteEventRef=OpEventGetShutdownTarget_GetShutdownTarget_EcuM_ShutdownTarget
          OpEventGetLastShutdownTarget_GetLastShutdownTarget_EcuM_ShutdownTarget: RteEventRef=OpEventGetLastShutdownTarget_GetLastShutdownTarget_EcuM_ShutdownTarget
          OpEventSelectShutdownCause_SelectShutdownCause_EcuM_ShutdownTarget: RteEventRef=OpEventSelectShutdownCause_SelectShutdownCause_EcuM_ShutdownTarget
          OpEventGetShutdownCause_GetShutdownCause_EcuM_ShutdownTarget: RteEventRef=OpEventGetShutdownCause_GetShutdownCause_EcuM_ShutdownTarget
          OpEventSelectBootTarget_SelectBootTarget_EcuM_BootTarget: RteEventRef=OpEventSelectBootTarget_SelectBootTarget_EcuM_BootTarget
          OpEventGetBootTarget_GetBootTarget_EcuM_BootTarget: RteEventRef=OpEventGetBootTarget_GetBootTarget_EcuM_BootTarget
      Det_EcuSwComposition: RteSoftwareComponentInstanceRef=Det
      ComM_EcuSwComposition: RteSoftwareComponentInstanceRef=ComM
        13 x RteEventToTaskMapping, all with RteImmediateRestart=false:
          Timer_ComM_MainFunction_0: RteEventRef=Timer_ComM_MainFunction_0
          OpEventGetInhibitionStatus_GetInhibitionStatus_CL_CN_CAN00_a2373004: RteEventRef=OpEventGetInhibitionStatus_GetInhibitionStatus_CL_CN_CAN00_a2373004
          OpEventGetInhibitionStatus_GetInhibitionStatus_CW_CN_CAN00_a2373004: RteEventRef=OpEventGetInhibitionStatus_GetInhibitionStatus_CW_CN_CAN00_a2373004
          OpEventLimitECUToNoComMode_LimitECUToNoComMode_modeLimitation: RteEventRef=OpEventLimitECUToNoComMode_LimitECUToNoComMode_modeLimitation
          OpEventReadInhibitCounter_ReadInhibitCounter_modeLimitation: RteEventRef=OpEventReadInhibitCounter_ReadInhibitCounter_modeLimitation
          OpEventResetInhibitCounter_ResetInhibitCounter_modeLimitation: RteEventRef=OpEventResetInhibitCounter_ResetInhibitCounter_modeLimitation
          OpEventSetECUGroupClassification_SetECUGroupClassification_modeLimitation: RteEventRef=OpEventSetECUGroupClassification_SetECUGroupClassification_modeLimitation
          OpEventLimitChannelToNoComMode_LimitChannelToNoComMode_CL_CN_CAN00_a2373004: RteEventRef=OpEventLimitChannelToNoComMode_LimitChannelToNoComMode_CL_CN_CAN00_a2373004
          OpEventPreventWakeUp_PreventWakeUp_CW_CN_CAN00_a2373004: RteEventRef=OpEventPreventWakeUp_PreventWakeUp_CW_CN_CAN00_a2373004
          OpEventRequestComMode_RequestComMode_UR_CN_CAN00_68d36c54: RteEventRef=OpEventRequestComMode_RequestComMode_UR_CN_CAN00_68d36c54
          OpEventGetCurrentComMode_GetCurrentComMode_UR_CN_CAN00_68d36c54: RteEventRef=OpEventGetCurrentComMode_GetCurrentComMode_UR_CN_CAN00_68d36c54
          OpEventGetMaxComMode_GetMaxComMode_UR_CN_CAN00_68d36c54: RteEventRef=OpEventGetMaxComMode_GetMaxComMode_UR_CN_CAN00_68d36c54
          OpEventGetRequestedComMode_GetRequestedComMode_UR_CN_CAN00_68d36c54: RteEventRef=OpEventGetRequestedComMode_GetRequestedComMode_UR_CN_CAN00_68d36c54
      BswM_EcuSwComposition: RteSoftwareComponentInstanceRef=BswM
        Timer_BswM_MainFunction (RteEventToTaskMapping): RteImmediateRestart=false, RteEventRef=Timer_BswM_MainFunction
      MySWC_EcuSwComposition: RteSoftwareComponentInstanceRef=MySWC
    MySWC (RteSwComponentType): RteComponentTypeRef=MySWC, RteImplementationRef=MySWC_Implementation
      ComponentTypeCalibration (RteComponentTypeCalibration): RteCalibrationSupportEnabled=false
