AUTOSAR XML (schema 00046)
package /ActiveEcuC
  module config Can: implementation-config-variant=VARIANT-PRE-COMPILE, module-description=Can_Impl
    CanGeneral:
      CanIndex = 0
      CanChangeBaudrateApi = false
      CanDevErrorDetection = true
      CanHardwareCancellation = false
      CanIdenticalIdCancellation = false
      CanMainFunctionBusoffPeriod = 0.01
      CanMainFunctionModePeriod = 0.01
      CanMainFunctionWakeupPeriod = 0.01
      CanMultiplexedTransmission = false
      CanSetBaudrateApi = false
      CanTimeoutDuration = 0.01
      CanVersionInfoApi = false
      CanGenericPrecopy = false
      CanHardwareLoopCheck = false
      CanRxFullCANSupport = false
      CanTxFullCANSupport = false
      CanRxBasicCANSupport = true
      CanUseNestedCANInterrupts = false
      CanHardwareCancelByAppl = false
      CanIndividualProcessing = false
      CanGenericConfirmation = false
      CanGenericConfirmationAPI2 = false
      CanRxQueue = false
      CanSupportMixedID = false
      CanRxQueueSize = 10
      CanMultipleBasicCANObjects = false
      CanMultipleBasicCANTxObjects = false
      CanHardwareHandleType = UINT8
      CanOptimizeOneController = true
      CanInterruptCategory = CATEGORY2
      CanGetStatus = false
      CanInterruptLock = DRIVER
      CanWakeupSupport = false
      CanRamCheck = None
      CanOverrunNotification = DET
      CanReinitStart = false
      CanGenericPreTransmit = false
      CanFdSupport = NONE
      CanRuntimeMeasurementSupport = false
      CanMaxRxDataLen = 8
      CanMaxTxDataLen = 8
      CanUsePeripheralAccessApi = false
      CanMirrorModeSupport = false
      CanUseOsInterruptControl = false
      CanSafeBswChecks = false
      CanSilentModeSupport = false
      CanHwTxFifoSupport = false
      CanCheckWakeupCanRetType = false
      CanFdHardwareBufferOptimization = false
      CanCounterRef = SystemTimer
      CanMainFunctionRWPeriods
    CanConfigSet
      CN_CAN00_a2373004_Tx (CanHardwareObject):
        CanHandleType = BASIC
        CanIdValue = 0
        CanObjectType = TRANSMIT
        CanIdType = STANDARD
        CanObjectId = 0
        CanHwProcessing = false
        CanObjectHwSize = 1
        CanObjectHwHandle = 0
        CanMaxDataLen = 8
        CanFdPaddingValue = 0
        CanObjectMultiplexedTransmission = false
        CanObjectHwFifo = false
        CanControllerRef = CT_CAN00_6199f384
      CT_CAN00_6199f384 (CanController):
        CanControllerActivation = true
        CanBusoffProcessing = INTERRUPT
        CanControllerBaseAddress = 0
        CanControllerId = 0
        CanRxProcessing = INTERRUPT
        CanTxProcessing = INTERRUPT
        CanWakeupProcessing = INTERRUPT
        CanWakeupSupport = false
        CanWakeupSourceId = 0
        CanBusName = CAN
        CanControllerDefaultBaudrate = CanControllerBaudrateConfig
        CanControllerSystemRef = CT_CAN00
        CanWakeupSourceRef = CN_CAN00_a2373004
        CanCpuClockRef = McuClockReferencePoint
        CanControllerBaudrateConfig:
          CanControllerBaudRate = 500
          CanControllerBaudRateConfigID = 0
          CanControllerPropSeg = 7
          CanControllerSeg1 = 4
          CanControllerSeg2 = 4
          CanControllerSyncJumpWidth = 1
          CanBaudrateClock = 80000
          CanBaudratePrescaler = 10
          CanSamplingMode = OneSample
        CanFilterMask: CanFilterMaskValue=0, CanFilterCodeValue=0, IsLocked=false
      CN_CAN00_193527e3_Rx (CanHardwareObject):
        CanHandleType = BASIC
        CanIdType = STANDARD
        CanIdValue = 0
        CanObjectType = RECEIVE
        CanObjectId = 1
        CanHwProcessing = false
        CanObjectHwSize = 2
        CanObjectHwHandle = 1
        CanMaxDataLen = 8
        CanFdPaddingValue = 0
        CanObjectMultiplexedTransmission = false
        CanObjectHwFifo = false
        CanControllerRef = CT_CAN00_6199f384
        CanFilterMaskRef = CanFilterMask
